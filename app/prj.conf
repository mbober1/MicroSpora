## CMakeLists.txt
```
# SPDX-License-Identifier: Apache-2.0

cmake_minimum_required(VERSION 3.20.0)

find_package(Zephyr REQUIRED HINTS $ENV{ZEPHYR_BASE})
project(bldc_app)

target_sources(app PRIVATE src/main.c)
```

## Kconfig
```
source "Kconfig.zephyr"

menu "BLDC speed controller"

config APP_SPEED_PID_KP_UA_PER_RPM
	int "Speed PID proportional gain (uA/RPM)"
	default 12000
	range 0 1000000
	help
	  Proportional gain for the speed PID. The default is 0.01 A/RPM.

config APP_SPEED_PID_KI_UA_PER_RPM
	int "Speed PID integral gain (uA/RPM per sample)"
	default 1000
	range 0 1000000
	help
	  Integral gain for the speed PID. Keep at zero until the controller has
	  been tuned and verified on current-limited hardware.

config APP_SPEED_PID_KD_UA_PER_RPM
	int "Speed PID derivative gain (uA/RPM per sample difference)"
	default 0
	range 0 1000000
	help
	  Derivative gain for the speed PID's discrete error samples.

config APP_SPEED_CURRENT_LIMIT_MA
	int "Speed controller current limit (mA)"
	default 250
	range 1 250
	help
	  Maximum magnitude of the q-axis current reference. This application
	  intentionally caps the configured limit at 250 mA.

config APP_SPEED_LOOP_PERIOD_MS
	int "Speed controller period (ms)"
	default 10
	range 1 100
	help
	  Fixed period between position PID updates.

endmenu
```

## west.yml
```
# Copyright (c) 2025 Marcin Bober
# SPDX-License-Identifier: Apache-2.0

manifest:
  self:
    path: app

  remotes:
    - name: mbober1
      url-base: https://github.com/mbober1
    - name: upstream
      url-base: https://github.com/zephyrproject-rtos

  projects:
    - name: zephyr
      remote: upstream
      repo-path: zephyr
      revision: v4.4.2
      import:
        name-allowlist:
          - cmsis
          - cmsis-dsp
          - cmsis_6
          - hal_stm32
          - segger

    - name: mt6701
      remote: mbober1
      repo-path: MT6701-Zephyr-Module
      path: modules/lib/mt6701
      revision: master

    - name: drv83xx
      remote: mbober1
      repo-path: drv83xx-Zephyr-Module
      path: modules/lib/drv83xx
      revision: master

    - name: spinner
      remote: mbober1
      repo-path: spinner
      path: modules/lib/spinner
      revision: main
 
```

## prj.conf
```kconfig
CONFIG_SPINNER_CURRSMP=y
CONFIG_SPINNER_FEEDBACK_MT6701=y
CONFIG_SPINNER_SVPWM=y
CONFIG_SPINNER_CLOOP=y

CONFIG_LOG=y
CONFIG_SHELL=y

CONFIG_SENSOR=y

CONFIG_DEBUG_OPTIMIZATIONS=y

CONFIG_BLDC=y
CONFIG_DRV83XX=y
CONFIG_FPU=y

CONFIG_MT6701_ENABLE_LAG=y
CONFIG_MT6701_LAG_VALUE=300

CONFIG_SPINNER_CLOOP_T_KP=2000
CONFIG_SPINNER_CLOOP_T_KI=0
CONFIG_SPINNER_CLOOP_F_KP=1500
CONFIG_SPINNER_CLOOP_F_KI=0
```

## debug.conf
```kconfig
# compiler
# CONFIG_DEBUG_OPTIMIZATIONS=y
CONFIG_NO_OPTIMIZATIONS=y

# console
CONFIG_CONSOLE=y

# UART console
CONFIG_SERIAL=y
CONFIG_UART_CONSOLE=y

# logging
CONFIG_LOG=y
```

## src/main.c
```c
#include <zephyr/logging/log.h>

LOG_MODULE_REGISTER(app, LOG_LEVEL_INF);

int main(void)
{
	while (true) {
	}

	return 0;
}
```

## src/main.cpp
```c
#include <stdio.h>
#include <zephyr/kernel.h>
#include <zephyr/drivers/gpio.h>
#include <zephyr/drivers/sensor.h>
#include "math.h"

#define LED0_NODE DT_ALIAS(led0)

static const struct gpio_dt_spec led = GPIO_DT_SPEC_GET(LED0_NODE, gpios);

int main(void)
{
	int ret;

	if (!gpio_is_ready_dt(&led)) {
		return 0;
	}

	ret = gpio_pin_configure_dt(&led, GPIO_OUTPUT_ACTIVE);
	if (ret < 0) {
		return 0;
	}

	const struct device *const dev = DEVICE_DT_GET(DT_ALIAS(encoder0));

	if (!device_is_ready(dev)) {
		printk("sensor: device not ready.\n");
		return 0;
	}

	printf("device is %p, name is %s\n", dev, dev->name);
static float value_deg;
static float value_vel;

	while (1) {
		// gpio_pin_toggle_dt(&led);

		ret = sensor_sample_fetch(dev);
		if (ret) {
			printk("sensor_sample_fetch failed ret %d\n", ret);
			return 0;
		}

		struct sensor_value angle;
		struct sensor_value velocity;
		sensor_channel_get(dev, SENSOR_CHAN_ROTATION, &angle);
		sensor_channel_get(dev, SENSOR_CHAN_RPM, &velocity);
		value_deg = sensor_value_to_float(&angle);
		value_vel = sensor_value_to_float(&velocity);
		// k_msleep(100);
	}
	return 0;
}
```
