## boards/st/microspora/Kconfig.microspora
```kconfig
# Copyright (c) 2019 Richard Osterloh <richard.osterloh@gmail.com>
# SPDX-License-Identifier: Apache-2.0

config BOARD_MICROSPORA
	select SOC_STM32G431XX
```

## boards/st/microspora/board.yml
```yaml
board:
  name: microspora
  full_name: MicroSpora
  vendor: st
  socs:
    - name: stm32g431xx
```
