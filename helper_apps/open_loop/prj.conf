## CMakeLists.txt
```
# SPDX-License-Identifier: Apache-2.0

cmake_minimum_required(VERSION 3.20.0)

find_package(Zephyr REQUIRED HINTS $ENV{ZEPHYR_BASE})
project(open_loop_app)

target_sources(app PRIVATE src/main.c)
```

## prj.conf
```kconfig
CONFIG_SENSOR=y

CONFIG_SPINNER_CURRSMP=y
CONFIG_SPINNER_SVPWM=y
CONFIG_SPINNER_SVPWM_STM32=y
CONFIG_SPINNER_CLOOP=y
CONFIG_SPINNER_FEEDBACK_MT6701=y

CONFIG_DEBUG_OPTIMIZATIONS=y
CONFIG_FPU=y
CONFIG_BLDC=y
CONFIG_DRV83XX=y
```

## src/main.c
```c
#include <arm_math.h>
#include <zephyr/device.h>
#include <zephyr/devicetree.h>
#include <zephyr/kernel.h>
#include <spinner/drivers/currsmp.h>
#include <spinner/drivers/svpwm.h>
#include <spinner/drivers/feedback.h>

#define VOLTAGE_AMPLITUDE 0.3f
#define ANGLE_STEP_DEGREES 5.0f
#define STEP_PERIOD_MS 1

const struct device *currsmp = DEVICE_DT_GET(DT_NODELABEL(currsmp));
const struct device *feedback = DEVICE_DT_GET(DT_NODELABEL(feedback));
struct currsmp_curr curr;
static volatile float measured_rpm;
static volatile float eangle;

static void noop_regulation_callback(void *ctx)
{
    eangle = feedback_get_eangle(feedback);
	measured_rpm = feedback_get_speed(feedback);
	currsmp_get_currents(currsmp, &curr);
    (void)ctx;
}

int main(void)
{
    const struct device *svpwm = DEVICE_DT_GET(DT_NODELABEL(svpwm));
    float angle = 0.0f;

    if (!device_is_ready(currsmp) || !device_is_ready(svpwm)) {
        return 0;
    }

	if (!device_is_ready(feedback)) {
		return 0;
	}

    currsmp_configure(currsmp, noop_regulation_callback, NULL);
    currsmp_start(currsmp);
    svpwm_start(svpwm);

    while (1) {
        float sine;
        float cosine;

        arm_sin_cos_f32(angle, &sine, &cosine);
        svpwm_set_phase_voltages(svpwm,
                                 VOLTAGE_AMPLITUDE * cosine,
                                 VOLTAGE_AMPLITUDE * sine);

        angle += ANGLE_STEP_DEGREES;
        if (angle >= 360.0f) {
            angle -= 360.0f;
        }

        k_msleep(STEP_PERIOD_MS);
    }

    return 0;
}
```
